## boards/arm/stm32f103_core/Kconfig.board
```kconfig
# Kconfig - STM32 Minimum Development Board Configuration
#
# Copyright (c) 2017, embedjournal.com
#
# SPDX-License-Identifier: Apache-2.0
#
config BOARD_STM32F103_CORE
	bool "STM32F103_C8T6 Core Board"
	depends on SOC_STM32F103X8
```

## boards/arm/stm32f103_core/Kconfig.defconfig
```kconfig
# Kconfig - STM32 Minimum Development Board Configuration
#
# Copyright (c) 2017, embedjournal.com
#
# SPDX-License-Identifier: Apache-2.0
#

if BOARD_STM32F103_CORE

config BOARD
	default "stm32f103_core"

if UART_CONSOLE

config UART_STM32_PORT_1
	default y

endif # UART_CONSOLE

endif # BOARD_STM32F103_CORE
```
